## main/Kconfig.projbuild
```kconfig
menu "Aquarium WiFi Settings"

    config WIFI_SSID
        string "WiFi SSID"
        default "your_ssid"
        help
            SSID (network name) of the WiFi access point to connect to.
            Can be overridden at runtime via the provisioning portal (AP mode).

    config WIFI_PASSWORD
        string "WiFi Password"
        default "your_password"
        help
            Password for the WiFi access point.
            Can be overridden at runtime via the provisioning portal (AP mode).

endmenu

menu "Aquarium Timezone Settings"

    config AQUARIUM_DEFAULT_TZ
        string "Default POSIX timezone string"
        default "CET-1CEST,M3.5.0/2,M10.5.0/3"
        help
            POSIX TZ string applied at startup if no timezone has been
            saved in NVS.  Can be changed at runtime via the Web UI
            (Manutenzione → Fuso Orario) and is stored in NVS.
            Examples:
              Italy (CET):   CET-1CEST,M3.5.0/2,M10.5.0/3
              UK (GMT/BST):  GMT0BST,M3.5.0/1,M10.5.0
              US East:       EST5EDT,M3.2.0,M11.1.0
              Japan (JST):   JST-9

endmenu

menu "Aquarium LED Strip Settings"

    config LED_STRIP_GPIO
        int "LED strip data GPIO"
        default 8
        help
            GPIO pin connected to the data line of the WS2812B LED strip.

    config LED_STRIP_NUM_LEDS
        int "Number of LEDs"
        default 105
        range 1 1024
        help
            Total number of LEDs in the WS2812B strip.

    config LED_STRIP_DEFAULT_BRIGHTNESS
        int "Default brightness (0-255)"
        default 128
        range 0 255
        help
            Default brightness level for the LED strip at startup.

    config LED_RAMP_DURATION_SEC
        int "Manual on/off acclimatization ramp (seconds)"
        default 30
        range 0 120
        help
            Duration of the gradual fade-in / fade-out ramp when the
            LED strip is turned on or off manually.  Set to 0 to disable
            (instant on/off).  Recommended: 30 s for fish welfare.

endmenu

menu "Aquarium Temperature Sensor Settings"

    config DS18B20_GPIO
        int "DS18B20 data GPIO"
        default 21
        help
            GPIO pin connected to the data line of the DS18B20 temperature sensor.
            A 4.7 kΩ pull-up resistor to 3.3 V is recommended on this line.

    config DS18B20_READ_INTERVAL_MS
        int "Temperature read interval (ms)"
        default 5000
        range 1000 60000
        help
            How often the DS18B20 sensor is read, in milliseconds.

    config TEMP_HISTORY_INTERVAL_SEC
        int "Temperature history sampling interval (seconds)"
        default 300
        range 60 3600
        help
            How often a temperature reading is stored in the 24-hour
            history ring buffer used for the daily chart.  The buffer
            holds 288 samples; at the default 300 s (5 min) interval
            this gives exactly 24 hours of data.

    config DS18B20_CALIBRATION_OFFSET_CENTI
        int "DS18B20 calibration offset (hundredths of °C)"
        default 0
        range -500 500
        help
            Constant offset added to every DS18B20 reading to compensate
            for sensor-to-sensor manufacturing variance.
            Value is in hundredths of a degree Celsius:
            e.g. -50 means subtract 0.50 °C, 25 means add 0.25 °C.

endmenu

menu "Aquarium Relay Settings"

    config RELAY_1_GPIO
        int "Relay 1 GPIO"
        default 28
        help
            GPIO pin connected to relay channel 1.
            On the Waveshare ESP32-P4-WiFi6 board the LED strip (GPIO20) and
            DS18B20 sensor (GPIO21) are on the RIGHT-side header; relays are
            placed on the LEFT-side header to keep the two harnesses separate.
            Left-side GPIOs available: 2, 3, 4, 5, 28, 29, 30, 31, 49, 50,
            51, 52 (GPIO7=SDA and GPIO8=SCL are reserved for touch I2C;
            GPIO24=DM and GPIO25=DP must NOT be used – USB bus).

    config RELAY_2_GPIO
        int "Relay 2 GPIO"
        default 29
        help
            GPIO pin connected to relay channel 2.
            See RELAY_1_GPIO for board-layout notes.

    config RELAY_3_GPIO
        int "Relay 3 GPIO"
        default 30
        help
            GPIO pin connected to relay channel 3.
            See RELAY_1_GPIO for board-layout notes.

    config RELAY_4_GPIO
        int "Relay 4 GPIO"
        default 31
        help
            GPIO pin connected to relay channel 4.
            See RELAY_1_GPIO for board-layout notes.

    config RELAY_ACTIVE_LOW
        bool "Relays are active-low"
        default y
        help
            Enable if your relay modules activate when the input is
            driven LOW (common for opto-isolated relay boards).
            When disabled, GPIO HIGH = relay ON.

endmenu

menu "Aquarium Display Settings"

    config DISPLAY_ENABLED
        bool "Enable touch display UI (LVGL)"
        default y
        help
            Enable the Waveshare 4-DSI-TOUCH-A 720×720 touch display with
            the LVGL-based dashboard.  Disable if no display is attached.

    config TOUCH_I2C_SCL
        int "GT911 touch I2C SCL GPIO"
        default 8
        depends on DISPLAY_ENABLED
        help
            GPIO for the I2C SCL line connected to the GT911 touch controller.
            On the Waveshare ESP32-P4-WiFi6 board this is GPIO 8.

    config TOUCH_I2C_SDA
        int "GT911 touch I2C SDA GPIO"
        default 7
        depends on DISPLAY_ENABLED
        help
            GPIO for the I2C SDA line connected to the GT911 touch controller.
            On the Waveshare ESP32-P4-WiFi6 board this is GPIO 7.

    config DISPLAY_BACKLIGHT_GPIO
        int "Backlight control GPIO (-1 = always on via hardware)"
        default -1
        range -1 54
        depends on DISPLAY_ENABLED
        help
            GPIO used to enable/disable the panel backlight.  Set to -1 if
            the backlight is wired permanently on or controlled by the panel
            itself (most Waveshare 4-DSI-TOUCH-A configurations).

endmenu

menu "Aquarium HTTPS Settings"

    config AQUARIUM_HTTPS_ENABLE
        bool "Enable HTTPS for the web server"
        default n
        help
            When enabled, the web server uses TLS (HTTPS) instead of plain HTTP.
            server.crt and server.key are embedded from the main/ directory.
            A self-signed certificate is pre-generated; the browser will show a
            security warning which must be accepted once.
            Protects Telegram credentials and WiFi passwords from LAN sniffing.

endmenu

menu "Aquarium Feeding Mode Settings"

    config FEEDING_DEFAULT_RELAY
        int "Default relay index for feeding pause (0-3, -1 = none)"
        default 0
        range -1 3
        help
            Relay channel that is paused (turned OFF) during feeding mode.
            Typically connected to the main filter/circulation pump.
            Set to -1 to disable relay control during feeding.

    config FEEDING_DEFAULT_DURATION_MIN
        int "Default feeding pause duration (minutes)"
        default 10
        range 1 60
        help
            How long the feeding pause lasts in minutes before automatically
            restoring the relay and LED state.

endmenu

menu "Aquarium Daily Cycle Settings"

    config DAILY_CYCLE_LATITUDE_E4
        int "Default latitude × 10000 (e.g. 454600 = 45.46°N)"
        default 454600
        range -900000 900000
        help
            Geographic latitude of the aquarium installation, expressed as
            an integer equal to the decimal-degree value multiplied by 10000.
            Used to compute real sunrise / sunset times for the daily lighting
            cycle.  Positive = North, negative = South.
            Examples: Milan 454600, Rome 418902, London 515060, New York 407128

    config DAILY_CYCLE_LONGITUDE_E4
        int "Default longitude × 10000 (e.g. 91900 = 9.19°E)"
        default 91900
        range -1800000 1800000
        help
            Geographic longitude of the aquarium installation, expressed as
            an integer equal to the decimal-degree value multiplied by 10000.
            Used to compute real sunrise / sunset times for the daily lighting
            cycle.  Positive = East, negative = West.
            Examples: Milan 91900, Rome 124942, London -1250, New York -740060

endmenu

menu "Aquarium LED Scene Settings"

    config LED_SCENE_SUNRISE_DURATION_MIN
        int "Default sunrise ramp duration (minutes)"
        default 30
        range 5 120
        help
            Time in minutes for the full sunrise colour ramp from darkness
            to daylight white.  A value of 30 minutes mimics a natural dawn.

    config LED_SCENE_SUNSET_DURATION_MIN
        int "Default sunset ramp duration (minutes)"
        default 30
        range 5 120
        help
            Time in minutes for the full sunset colour ramp from daylight
            white back to darkness.

    config LED_SCENE_MOONLIGHT_BRIGHTNESS
        int "Default moonlight brightness (0-60)"
        default 15
        range 0 60
        help
            LED brightness level during the moonlight scene.  Should be very
            dim (< 30) to simulate natural moonlight without disturbing fish.

endmenu

menu "Aquarium SD Card Settings"

    config SD_CARD_ENABLED
        bool "Enable SD card (SPI mode)"
        default y
        help
            Mount the onboard microSD card slot via the SPI2 (HSPI) peripheral
            in SD-SPI mode.
            When enabled, data logging, config backup/restore and local OTA are
            available.  Disable only if no SD card is physically present and you
            want to save the mount attempt time at boot.

            Both SDMMC host controllers on ESP32-P4 are occupied by the
            esp_hosted WiFi coprocessor SDIO transport, so SDMMC mode is
            unavailable.  SPI2 is free and fully compatible with the onboard
            TF card slot.

    if SD_CARD_ENABLED

    config SD_CLK_GPIO
        int "SPI2 CLK (SCLK) GPIO"
        default 43
        range 0 56
        help
            GPIO number for the SPI clock signal to the SD card.
            On the Waveshare ESP32-P4-WiFi6 board the onboard TF slot
            connects this pin to GPIO 43.

    config SD_CMD_GPIO
        int "SPI2 MOSI (CMD) GPIO"
        default 44
        range 0 56
        help
            GPIO number for the SPI MOSI signal (SD card CMD pin).
            Corresponds to GPIO 44 on the Waveshare ESP32-P4-WiFi6.

    config SD_D0_GPIO
        int "SPI2 MISO (D0) GPIO"
        default 39
        range 0 56
        help
            GPIO number for the SPI MISO signal (SD card D0 pin).
            Corresponds to GPIO 39 on the Waveshare ESP32-P4-WiFi6.

    config SD_D3_GPIO
        int "SPI2 CS (D3) GPIO"
        default 38
        range 0 56
        help
            GPIO number for the SPI chip-select signal (SD card D3 pin).
            Corresponds to GPIO 38 on the Waveshare ESP32-P4-WiFi6.

    endif # SD_CARD_ENABLED

endmenu
```
