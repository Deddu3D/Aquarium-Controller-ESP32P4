## sdkconfig.defaults
```kconfig
# ===========================================================================
# Aquarium Controller – sdkconfig.defaults
# Target board: Waveshare ESP32-P4-WiFi6 rev 1.3
# ESP-IDF v6.0.0
#
# These defaults are applied when running `idf.py set-target esp32p4`
# followed by `idf.py build`. User changes via menuconfig are saved
# in the sdkconfig file and take precedence.
# ===========================================================================

# ── Target ──────────────────────────────────────────────────────────
CONFIG_IDF_TARGET="esp32p4"

# ── Chip revision ────────────────────────────────────────────────────
# The Waveshare ESP32-P4-WiFi6 board carries a v1.3 chip.
# ESP-IDF v6.0 defaults to requiring rev ≥ v3.1; override so the
# bootloader is built for v1.0 and accepts any v1.x silicon.
# Encoding: major*100 + minor  →  v1.0 = 100
CONFIG_ESP32P4_REV_MIN_FULL=100

# ── Flash configuration (16 MB usable NOR Flash) ───────────────────
CONFIG_ESPTOOLPY_FLASHSIZE_16MB=y
CONFIG_ESPTOOLPY_FLASHMODE_QIO=y
CONFIG_ESPTOOLPY_FLASHFREQ_80M=y

# ── Partition table ─────────────────────────────────────────────────
CONFIG_PARTITION_TABLE_CUSTOM=y
CONFIG_PARTITION_TABLE_CUSTOM_FILENAME="partitions.csv"

# ── PSRAM (32 MB octal PSRAM on board) ──────────────────────────────
CONFIG_SPIRAM=y
CONFIG_SPIRAM_MODE_OCT=y
CONFIG_SPIRAM_SPEED_80M=y

# ── ESP-Hosted / WiFi Remote  ──────────────────────────────────────
# The esp_wifi_remote + esp_hosted components handle the SDIO transport
# between the ESP32-P4 (host) and the ESP32-C6 (slave/coprocessor).
# Pin mapping for the Waveshare ESP32-P4-WiFi6 board:
#   SDIO_CLK  = GPIO 18
#   SDIO_CMD  = GPIO 19
#   SDIO_D0   = GPIO 14
#   SDIO_D1   = GPIO 15
#   SDIO_D2   = GPIO 16
#   SDIO_D3   = GPIO 17
#   RESET     = GPIO 54

CONFIG_ESP_SDIO_PIN_CLK=18
CONFIG_ESP_SDIO_PIN_CMD=19
CONFIG_ESP_SDIO_PIN_D0=14
CONFIG_ESP_SDIO_PIN_D1=15
CONFIG_ESP_SDIO_PIN_D2=16
CONFIG_ESP_SDIO_PIN_D3=17
CONFIG_ESP_HOSTED_GPIO_SLAVE_RESET=54

# ── Logging ─────────────────────────────────────────────────────────
CONFIG_LOG_DEFAULT_LEVEL_INFO=y

# ── FreeRTOS ────────────────────────────────────────────────────────
CONFIG_FREERTOS_HZ=1000

# ── WiFi default settings ──────────────────────────────────────────
CONFIG_WIFI_SSID="your_ssid"
CONFIG_WIFI_PASSWORD="your_password"

# ── LED strip (WS2812B) ───────────────────────────────────────────
CONFIG_LED_STRIP_GPIO=20
CONFIG_LED_STRIP_NUM_LEDS=105
CONFIG_LED_STRIP_DEFAULT_BRIGHTNESS=128

# ── DS18B20 temperature sensor ────────────────────────────────────
CONFIG_DS18B20_GPIO=21
CONFIG_DS18B20_READ_INTERVAL_MS=5000
CONFIG_TEMP_HISTORY_INTERVAL_SEC=300
CONFIG_DS18B20_CALIBRATION_OFFSET_CENTI=0

# ── Relay defaults ────────────────────────────────────────────────
# LED strip (GPIO20) and DS18B20 (GPIO21) occupy the RIGHT-side header.
# Relays 1–4 use GPIO28/29/30/31 on the LEFT-side header so the two
# harnesses stay physically separated.
# Available header GPIOs (from board silkscreen):
#   Right side: 20, 21, 22, 23, 26, 27, 32, 33, 46, 47, 48
#   Left  side: 2, 3, 4, 5, 7(SDA), 8(SCL), 28, 29, 30, 31, 49, 50, 51, 52
# NOTE: GPIO24 (DM/USB D-) and GPIO25 (DP/USB D+) must NOT be used.
# NOTE: GPIO7 (SDA) and GPIO8 (SCL) are reserved for display touch I2C.
CONFIG_RELAY_1_GPIO=28
CONFIG_RELAY_2_GPIO=29
CONFIG_RELAY_3_GPIO=30
CONFIG_RELAY_4_GPIO=31
CONFIG_RELAY_ACTIVE_LOW=y

# ── FreeRTOS hardening ────────────────────────────────────────────
CONFIG_FREERTOS_CHECK_STACKOVERFLOW_CANARY=y

# ── HTTPS / TLS (required for Telegram Bot API) ──────────────────
CONFIG_ESP_TLS_USING_MBEDTLS=y
CONFIG_MBEDTLS_CERTIFICATE_BUNDLE=y
CONFIG_MBEDTLS_CERTIFICATE_BUNDLE_DEFAULT_FULL=y

# ── Touch Display (Waveshare 4-DSI-TOUCH-A, 720×720, HX8394 + GT911) ──
CONFIG_DISPLAY_ENABLED=y
CONFIG_TOUCH_I2C_SCL=8
CONFIG_TOUCH_I2C_SDA=7
CONFIG_DISPLAY_BACKLIGHT_GPIO=-1

# ── LVGL v9 (from ESP Component Registry) ────────────────────────────
# Colour depth 16-bit (RGB565) matches the DSI panel pixel format
CONFIG_LV_COLOR_DEPTH=16
# Enable Montserrat fonts used by the dashboard
CONFIG_LV_FONT_MONTSERRAT_14=y
CONFIG_LV_FONT_MONTSERRAT_16=y
CONFIG_LV_FONT_MONTSERRAT_20=y
CONFIG_LV_FONT_MONTSERRAT_28=y
# Enable flex/grid layout engines
CONFIG_LV_USE_FLEX=y
CONFIG_LV_USE_GRID=y
# Enable all widgets used by the UI
CONFIG_LV_USE_TABVIEW=y
CONFIG_LV_USE_SWITCH=y
CONFIG_LV_USE_SLIDER=y
CONFIG_LV_USE_SPINBOX=y
CONFIG_LV_USE_TEXTAREA=y
CONFIG_LV_USE_KEYBOARD=y
CONFIG_LV_USE_DROPDOWN=y
CONFIG_LV_USE_ARC=y
CONFIG_LV_USE_CHART=y

# ── Feeding Mode defaults ─────────────────────────────────────────
CONFIG_FEEDING_DEFAULT_RELAY=0
CONFIG_FEEDING_DEFAULT_DURATION_MIN=10

# ── LED Scene defaults ────────────────────────────────────────────
CONFIG_LED_SCENE_SUNRISE_DURATION_MIN=30
CONFIG_LED_SCENE_SUNSET_DURATION_MIN=30
CONFIG_LED_SCENE_MOONLIGHT_BRIGHTNESS=15

# ── SD Card defaults (Waveshare ESP32-P4-WiFi6 onboard TF slot, SPI mode) ──
# SPI mode is required because SDMMC_HOST_SLOT_1 is already occupied by the
# esp_hosted WiFi coprocessor SDIO transport (GPIOs 14-19).
# The same physical pins are used in both modes:
#   SPI_CLK  = GPIO 43  (SDMMC1_CLK)
#   SPI_MOSI = GPIO 44  (SDMMC1_CMD)
#   SPI_MISO = GPIO 39  (SDMMC1_D0)
#   SPI_CS   = GPIO 38  (SDMMC1_D3 / SD card SPI CS)
CONFIG_SD_CARD_ENABLED=y
CONFIG_SD_CLK_GPIO=43
CONFIG_SD_CMD_GPIO=44
CONFIG_SD_D0_GPIO=39
CONFIG_SD_CS_GPIO=38
```
